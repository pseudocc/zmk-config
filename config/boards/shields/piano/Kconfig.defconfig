## config/boards/shields/piano/Kconfig.defconfig
```kconfig
# vim: ft=kconfig ts=4 sts=4 sw=4 noet

config ZMK_KSCAN_DEBOUNCE_RELEASE_MS
	default 10

if SHIELD_PIANO_RIGHT

config ZMK_KEYBOARD_NAME
	default "The Piano 2"

config ZMK_SPLIT_ROLE_CENTRAL
	default y

endif # SHIELD_PIANO_RIGHT

if SHIELD_PIANO_LEFT || SHIELD_PIANO_RIGHT

config ZMK_SPLIT
	default y

endif # SHIELD_PIANO_LEFT || SHIELD_PIANO_RIGHT
```

## config/boards/shields/piano/Kconfig.shield
```kconfig
# vim: ft=kconfig ts=4 sts=4 sw=4 noet

config SHIELD_PIANO_LEFT
	def_bool $(shields_list_contains,piano_left)

config SHIELD_PIANO_RIGHT
	def_bool $(shields_list_contains,piano_right)
```

## config/west.yml
```yaml
manifest:
  remotes:
    - name: pseudocc
      url-base: https://github.com/pseudocc
    - name: urob
      url-base: https://github.com/urob
  projects:
    - name: zmk
      remote: urob
      revision: main
      import: app/west.yml
  self:
    path: config
```
