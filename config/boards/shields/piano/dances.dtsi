// vim: ft=dts ts=4 sts=4 sw=4 et

/ {
    behaviors {
        td_PLUS_DOT: tap_dance_plus_dot {
            compatible = "zmk,behavior-tap-dance";
            label = "TAP_DANCE_PLUS_DOT";
            #binding-cells = <0>;
            bindings = <&kp PLUS>, <&kp DOT>;
        };

        td_MINUS_UNDER: tap_dance_minus_under {
            compatible = "zmk,behavior-tap-dance";
            label = "TAP_DANCE_MINUS_UNDER";
            #binding-cells = <0>;
            bindings = <&kp MINUS>, <&kp UNDER>;
        };
    };
};
